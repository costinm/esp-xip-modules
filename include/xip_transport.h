/* GENERATED by tools/gen_profile.py from abi/API.md. */
#pragma once
#include "xip.h"
#include "xip_cbor.h"
#include <string.h>
static inline void xip_transport_default(xip_bearer_profile *p) {
    memset(p, 0, sizeof(*p)); p->size = sizeof(*p);
    p->version = 1;
    p->nan_dw_interval = 1;
    p->ap = 1;
    p->uart = 1;
    p->uart_mode = 2;
    p->uart_baud = 115200;
    p->sta_driver_tx = 1;
    p->sta_bssid_check_disabled = 1;
    p->sta_ampdu_enabled = 1;
    p->sta_11b_rates_disabled = 1;
    p->sta_raw_rx_enabled = 1;
}
static inline void xip_transport_off(xip_bearer_profile *p) {
    xip_transport_default(p); p->mode = 0; p->run_requested = 0; p->ap = 0; p->now = 2;
    p->nan_dw_interval = 0; p->uart = 8; p->uart_mode = 0; p->ble = 0; p->radio_mode = 0;
}
static inline int xip_transport_validate(const xip_bearer_profile *p) {
    if (!p || p->size < sizeof(*p) || p->version != 1) return -1;
    if (p->mode != 0 && p->mode != 1 && p->mode != 5 && p->mode != 6) return -1;
    if (p->run_requested > 1 || p->sta_bssid_set > 1) return -1;
    if (p->ssid_len > 32 || memchr(p->ssid, 0, p->ssid_len)) return -1;
    if (!(p->sta_channel == 0 || (p->sta_channel >= 1 && p->sta_channel <= 14))) return -1;
    if (!(p->raw_tx_rate == 0 || p->raw_tx_rate == 6 || p->raw_tx_rate == 9 || p->raw_tx_rate == 12 || p->raw_tx_rate == 18 || p->raw_tx_rate == 24 || p->raw_tx_rate == 36 || p->raw_tx_rate == 48 || p->raw_tx_rate == 54)) return -1;
    if (!(p->sta_driver_tx <= 1)) return -1;
    if (!(p->sta_bssid_check_disabled <= 1)) return -1;
    if (!(p->sta_ampdu_enabled <= 1)) return -1;
    if (!(p->sta_11b_rates_disabled <= 1)) return -1;
    if (!(p->sta_raw_rx_enabled <= 1)) return -1;
    if (!(p->espnow_capture <= 1)) return -1;
    if (!(p->nan_dw_interval == 0 || p->nan_dw_interval == 1 || p->nan_dw_interval == 8 || p->nan_dw_interval == 16)) return -1;
    if (!(p->now <= 2)) return -1;
    if (!(p->ap <= 1)) return -1;
    if (p->sta_passphrase_len > 63 || memchr(p->sta_passphrase, 0, p->sta_passphrase_len)) return -1;
    if (p->sta_passphrase_len && p->sta_passphrase_len < 8) return -1;
    if (!(p->uart <= 9)) return -1;
    if (!(p->ndp <= 1)) return -1;
    if (!(p->open <= 1)) return -1;
    if (!(p->ble <= 2)) return -1;
    if (!(p->uart_mode <= 2)) return -1;
    if (!(p->uart_baud > 0 && p->uart_baud <= 5000000)) return -1;
    if (!(p->uart_port <= 3)) return -1;
    if (!(p->radio_mode <= 2)) return -1;
    if (!(1)) return -1;
    if (!(1)) return -1;
    if (!(1)) return -1;
    if (!(p->radio_tx_power >= -40 && p->radio_tx_power <= 30)) return -1;
    if (!(p->radio_spreading_factor == 0 || (p->radio_spreading_factor >= 5 && p->radio_spreading_factor <= 12))) return -1;
    if (!(p->radio_coding_rate == 0 || (p->radio_coding_rate >= 5 && p->radio_coding_rate <= 8))) return -1;
    if (p->ap_ssid_len > 32 || memchr(p->ap_ssid, 0, p->ap_ssid_len)) return -1;
    if (p->ap_passphrase_len > 63 || memchr(p->ap_passphrase, 0, p->ap_passphrase_len)) return -1;
    if (p->ap_passphrase_len && p->ap_passphrase_len < 8) return -1;
    return 0;
}
static inline int xip_transport_mac(const xip_cbor_item *v, uint8_t out[6]) {
    if (v->type == XIP_CBOR_BYTES && v->n == 6) { memcpy(out, v->data, 6); return 0; }
    if (v->type != XIP_CBOR_TEXT || v->n != 17) return -1;
    for (unsigned i = 0; i < 6; ++i) {
        if (i != 5 && v->data[i*3+2] != 58) return -1;
        unsigned byte = 0;
        for (unsigned j = 0; j < 2; ++j) { unsigned c = v->data[i*3+j];
            unsigned n = c >= 48 && c <= 57 ? c-48 : c >= 65 && c <= 70 ? c-55 : c >= 97 && c <= 102 ? c-87 : 255;
            if (n == 255) return -1;
            byte = byte*16+n;
        } out[i] = byte;
    } return 0;
}
static inline int xip_transport_decode_fields(const uint8_t *data, size_t len, xip_bearer_profile *p) {
    xip_bearer_profile candidate = *p; xip_bearer_profile *original = p; p = &candidate;
    xip_cbor_r r = {data, len}; xip_cbor_item map, key, value; uint64_t seen = 0;
    if (xip_cbor_next(&r, &map) || map.type != XIP_CBOR_MAP) return -1;
    for (size_t i = 0; i < map.n; ++i) {
        if (xip_cbor_next(&r, &key) || key.type != XIP_CBOR_UINT) return -1;
        if (key.arg < 64) { uint64_t bit = (uint64_t)1 << key.arg; if (seen & bit) return -1; seen |= bit; }
        xip_cbor_r saved = r;
        if (xip_cbor_next(&r, &value)) return -1;
        switch (key.arg) {
        case 1: if (value.type != XIP_CBOR_UINT || (value.arg != 0 && value.arg != 1 && value.arg != 5 && value.arg != 6)) return -1;
            p->mode = value.arg; break;
        case 2:
            if ((value.type != XIP_CBOR_TEXT && value.type != XIP_CBOR_BYTES) || value.n < 1 || value.n > 32 || memchr(value.data, 0, value.n)) return -1;
            memset(p->ssid, 0, sizeof(p->ssid)); memcpy(p->ssid, value.data, value.n); p->ssid_len = value.n; break;
        case 3:
            if (xip_transport_mac(&value, p->sta_bssid)) return -1;
            p->sta_bssid_set = 1; break;
        case 4:
            if (value.type != XIP_CBOR_UINT || value.arg > 255u || !(value.arg >= 1 && value.arg <= 14)) return -1;
            p->sta_channel = value.arg; break;
        case 5:
            if (value.type != XIP_CBOR_UINT || value.arg > 255u || !(value.arg == 0 || value.arg == 6 || value.arg == 9 || value.arg == 12 || value.arg == 18 || value.arg == 24 || value.arg == 36 || value.arg == 48 || value.arg == 54)) return -1;
            p->raw_tx_rate = value.arg; break;
        case 6:
            if (value.type != XIP_CBOR_BOOL) return -1;
            p->sta_driver_tx = value.arg; break;
        case 7:
            if (value.type != XIP_CBOR_BOOL) return -1;
            p->sta_bssid_check_disabled = value.arg; break;
        case 8:
            if (value.type != XIP_CBOR_BOOL) return -1;
            p->sta_ampdu_enabled = value.arg; break;
        case 9:
            if (value.type != XIP_CBOR_BOOL) return -1;
            p->sta_11b_rates_disabled = value.arg; break;
        case 10:
            if (value.type != XIP_CBOR_BOOL) return -1;
            p->sta_raw_rx_enabled = value.arg; break;
        case 13:
            if (value.type != XIP_CBOR_BOOL) return -1;
            p->espnow_capture = value.arg; break;
        case 14:
            if (value.type != XIP_CBOR_UINT || value.arg > 255u || !(value.arg == 0 || value.arg == 1 || value.arg == 8 || value.arg == 16)) return -1;
            p->nan_dw_interval = value.arg; break;
        case 15:
            if (value.type != XIP_CBOR_UINT || value.arg > 255u || !(value.arg <= 2)) return -1;
            p->now = value.arg; break;
        case 16:
            if (value.type != XIP_CBOR_UINT || value.arg > 255u || !(value.arg <= 1)) return -1;
            p->ap = value.arg; break;
        case 17:
            if ((value.type != XIP_CBOR_TEXT && value.type != XIP_CBOR_BYTES) || value.n < 8 || value.n > 63 || memchr(value.data, 0, value.n)) return -1;
            memset(p->sta_passphrase, 0, sizeof(p->sta_passphrase)); memcpy(p->sta_passphrase, value.data, value.n); p->sta_passphrase_len = value.n; break;
        case 18:
            if (value.type != XIP_CBOR_UINT || value.arg > 255u || !(value.arg <= 9)) return -1;
            p->uart = value.arg; break;
        case 19:
            if (value.type != XIP_CBOR_UINT || value.arg > 255u || !(value.arg <= 1)) return -1;
            p->ndp = value.arg; break;
        case 24:
            if (value.type != XIP_CBOR_BOOL) return -1;
            p->open = value.arg; break;
        case 26:
            if (value.type != XIP_CBOR_UINT || value.arg > 255u || !(value.arg <= 2)) return -1;
            p->ble = value.arg; break;
        case 28:
            if (value.type != XIP_CBOR_UINT || value.arg > 255u || !(value.arg <= 2)) return -1;
            p->uart_mode = value.arg; break;
        case 29:
            if (value.type != XIP_CBOR_UINT || value.arg > 4294967295u || !(value.arg > 0 && value.arg <= 5000000)) return -1;
            p->uart_baud = value.arg; break;
        case 30:
            if (value.type != XIP_CBOR_UINT || value.arg > 255u || !(value.arg <= 3)) return -1;
            p->uart_port = value.arg; break;
        case 31:
            if (value.type != XIP_CBOR_UINT || value.arg > 255u || !(value.arg <= 2)) return -1;
            p->radio_mode = value.arg; break;
        case 32:
            if (value.type != XIP_CBOR_UINT || value.arg > 4294967295u || !(1)) return -1;
            p->radio_frequency = value.arg; break;
        case 33:
            if (value.type != XIP_CBOR_UINT || value.arg > 4294967295u || !(1)) return -1;
            p->radio_bandwidth = value.arg; break;
        case 34:
            if (value.type != XIP_CBOR_UINT || value.arg > 4294967295u || !(1)) return -1;
            p->radio_bitrate = value.arg; break;
        case 35:
            { int64_t number; if (xip_cbor_as_int(&value, &number) || number < -40 || number > 30) return -1;
            p->radio_tx_power = number; } break;
        case 36:
            if (value.type != XIP_CBOR_UINT || value.arg > 255u || !(value.arg == 0 || (value.arg >= 5 && value.arg <= 12))) return -1;
            p->radio_spreading_factor = value.arg; break;
        case 37:
            if (value.type != XIP_CBOR_UINT || value.arg > 255u || !(value.arg == 0 || (value.arg >= 5 && value.arg <= 8))) return -1;
            p->radio_coding_rate = value.arg; break;
        case 38:
            if ((value.type != XIP_CBOR_TEXT && value.type != XIP_CBOR_BYTES) || value.n < 1 || value.n > 32 || memchr(value.data, 0, value.n)) return -1;
            memset(p->ap_ssid, 0, sizeof(p->ap_ssid)); memcpy(p->ap_ssid, value.data, value.n); p->ap_ssid_len = value.n; break;
        case 39:
            if ((value.type != XIP_CBOR_TEXT && value.type != XIP_CBOR_BYTES) || value.n < 8 || value.n > 63 || memchr(value.data, 0, value.n)) return -1;
            memset(p->ap_passphrase, 0, sizeof(p->ap_passphrase)); memcpy(p->ap_passphrase, value.data, value.n); p->ap_passphrase_len = value.n; break;
        default: r = saved; if (xip_cbor_skip(&r)) return -1; break;
        }
    }
    if ((seen & ((uint64_t)1 << 18)) && !(seen & ((uint64_t)1 << 28))) p->uart_mode = p->uart == 8 ? 0 : 2;
    if ((seen & ((uint64_t)1 << 18)) && !(seen & ((uint64_t)1 << 29))) {
        static const uint32_t baud[] = {115200,115200,9600,19200,38400,57600,230400,460800,115200,921600}; p->uart_baud = baud[p->uart];
    }
    if ((seen & ((uint64_t)1 << 18)) && p->uart == 0) p->uart = 1;
    if (r.len || xip_transport_validate(p)) return -1;
    *original = candidate; return 0;
}
static inline int xip_transport_encode(const xip_bearer_profile *p, xip_cbor_w *w) {
    if (xip_transport_validate(p)) return -1;
    size_t count = 1;
    if (p->ssid_len != 0) ++count;
    if (p->sta_bssid_set) ++count;
    if (p->sta_channel != 0) ++count;
    if (1) ++count;
    if (1) ++count;
    if (1) ++count;
    if (1) ++count;
    if (1) ++count;
    if (1) ++count;
    if (1) ++count;
    if (1) ++count;
    if (1) ++count;
    if (1) ++count;
    if (p->sta_passphrase_len != 0) ++count;
    if (1) ++count;
    if (1) ++count;
    if (1) ++count;
    if (1) ++count;
    if (1) ++count;
    if (1) ++count;
    if (1) ++count;
    if (1) ++count;
    if (1) ++count;
    if (1) ++count;
    if (1) ++count;
    if (1) ++count;
    if (1) ++count;
    if (1) ++count;
    if (p->ap_ssid_len != 0) ++count;
    if (p->ap_passphrase_len != 0) ++count;
    xip_cbor_map(w, count); xip_cbor_uint(w, 1); xip_cbor_uint(w, p->mode);
    if (p->ssid_len != 0) { xip_cbor_uint(w, 2); xip_cbor_text(w, (const char *)p->ssid, p->ssid_len); }
    if (p->sta_bssid_set) { xip_cbor_uint(w, 3); xip_cbor_bytes(w, p->sta_bssid, 6); }
    if (p->sta_channel != 0) { xip_cbor_uint(w, 4); xip_cbor_uint(w, p->sta_channel); }
    if (1) { xip_cbor_uint(w, 5); xip_cbor_uint(w, p->raw_tx_rate); }
    if (1) { xip_cbor_uint(w, 6); xip_cbor_bool(w, p->sta_driver_tx); }
    if (1) { xip_cbor_uint(w, 7); xip_cbor_bool(w, p->sta_bssid_check_disabled); }
    if (1) { xip_cbor_uint(w, 8); xip_cbor_bool(w, p->sta_ampdu_enabled); }
    if (1) { xip_cbor_uint(w, 9); xip_cbor_bool(w, p->sta_11b_rates_disabled); }
    if (1) { xip_cbor_uint(w, 10); xip_cbor_bool(w, p->sta_raw_rx_enabled); }
    if (1) { xip_cbor_uint(w, 13); xip_cbor_bool(w, p->espnow_capture); }
    if (1) { xip_cbor_uint(w, 14); xip_cbor_uint(w, p->nan_dw_interval); }
    if (1) { xip_cbor_uint(w, 15); xip_cbor_uint(w, p->now); }
    if (1) { xip_cbor_uint(w, 16); xip_cbor_uint(w, p->ap); }
    if (p->sta_passphrase_len != 0) { xip_cbor_uint(w, 17); xip_cbor_text(w, (const char *)p->sta_passphrase, p->sta_passphrase_len); }
    if (1) { xip_cbor_uint(w, 18); xip_cbor_uint(w, p->uart); }
    if (1) { xip_cbor_uint(w, 19); xip_cbor_uint(w, p->ndp); }
    if (1) { xip_cbor_uint(w, 24); xip_cbor_bool(w, p->open); }
    if (1) { xip_cbor_uint(w, 26); xip_cbor_uint(w, p->ble); }
    if (1) { xip_cbor_uint(w, 28); xip_cbor_uint(w, p->uart_mode); }
    if (1) { xip_cbor_uint(w, 29); xip_cbor_uint(w, p->uart_baud); }
    if (1) { xip_cbor_uint(w, 30); xip_cbor_uint(w, p->uart_port); }
    if (1) { xip_cbor_uint(w, 31); xip_cbor_uint(w, p->radio_mode); }
    if (1) { xip_cbor_uint(w, 32); xip_cbor_uint(w, p->radio_frequency); }
    if (1) { xip_cbor_uint(w, 33); xip_cbor_uint(w, p->radio_bandwidth); }
    if (1) { xip_cbor_uint(w, 34); xip_cbor_uint(w, p->radio_bitrate); }
    if (1) { xip_cbor_uint(w, 35); xip_cbor_int(w, p->radio_tx_power); }
    if (1) { xip_cbor_uint(w, 36); xip_cbor_uint(w, p->radio_spreading_factor); }
    if (1) { xip_cbor_uint(w, 37); xip_cbor_uint(w, p->radio_coding_rate); }
    if (p->ap_ssid_len != 0) { xip_cbor_uint(w, 38); xip_cbor_text(w, (const char *)p->ap_ssid, p->ap_ssid_len); }
    if (p->ap_passphrase_len != 0) { xip_cbor_uint(w, 39); xip_cbor_text(w, (const char *)p->ap_passphrase, p->ap_passphrase_len); }
    return w->overflow ? -8 : 0;
}
static inline int xip_transport_apply_request(const uint8_t *data, size_t len, xip_bearer_profile *p) {
    xip_cbor_r field; xip_cbor_item mode; int selected = -1;
    if (!xip_cbor_get(data, len, 1, &field)) {
        if (xip_cbor_next(&field, &mode) || mode.type != XIP_CBOR_UINT || (mode.arg != 0 && mode.arg != 1 && mode.arg != 5 && mode.arg != 6)) return -1;
        selected = mode.arg; if (selected == 5) return -2;
    }
    /* Metadata needs a product hook; this minimal C owner has none. */
    if (!xip_cbor_get(data, len, 25, &field) || !xip_cbor_get(data, len, 27, &field)) return -2;
    int targeted = !xip_cbor_get(data, len, 2, &field) || !xip_cbor_get(data, len, 3, &field);
    if (selected == 1 && !targeted && !p->ssid_len && !p->sta_bssid_set) return -1;
    xip_bearer_profile candidate = *p;
    if (selected == 0) xip_transport_off(&candidate);
    if (selected == 1 && targeted) { memset(candidate.sta_passphrase, 0, sizeof(candidate.sta_passphrase)); candidate.sta_passphrase_len = 0; }
    int rc = xip_transport_decode_fields(data, len, &candidate); if (rc) return rc;
    if (selected >= 0) { candidate.mode = selected; candidate.run_requested = selected != 0; }
    *p = candidate; return 0;
}
static inline int xip_transport_equal(const xip_bearer_profile *a, const xip_bearer_profile *b) {
    if (a->ssid_len != b->ssid_len || memcmp(a->ssid, b->ssid, a->ssid_len)) return 0;
    if (a->sta_passphrase_len != b->sta_passphrase_len || memcmp(a->sta_passphrase, b->sta_passphrase, a->sta_passphrase_len)) return 0;
    if (a->sta_bssid_set && memcmp(a->sta_bssid, b->sta_bssid, 6)) return 0;
    if (a->sta_bssid_set != b->sta_bssid_set) return 0;
    if (a->sta_channel != b->sta_channel) return 0;
    if (a->espnow_capture != b->espnow_capture) return 0;
    if (a->nan_dw_interval != b->nan_dw_interval) return 0;
    if (a->now != b->now) return 0;
    if (a->ndp != b->ndp) return 0;
    if (a->ap != b->ap) return 0;
    if (a->open != b->open) return 0;
    if (a->uart != b->uart) return 0;
    if (a->ble != b->ble) return 0;
    if (a->uart_mode != b->uart_mode) return 0;
    if (a->uart_baud != b->uart_baud) return 0;
    if (a->uart_port != b->uart_port) return 0;
    if (a->radio_mode != b->radio_mode) return 0;
    if (a->radio_frequency != b->radio_frequency) return 0;
    if (a->radio_bandwidth != b->radio_bandwidth) return 0;
    if (a->radio_bitrate != b->radio_bitrate) return 0;
    if (a->radio_tx_power != b->radio_tx_power) return 0;
    if (a->radio_spreading_factor != b->radio_spreading_factor) return 0;
    if (a->radio_coding_rate != b->radio_coding_rate) return 0;
    if (a->ap_ssid_len != b->ap_ssid_len || memcmp(a->ap_ssid, b->ap_ssid, a->ap_ssid_len)) return 0;
    if (a->ap_passphrase_len != b->ap_passphrase_len || memcmp(a->ap_passphrase, b->ap_passphrase, a->ap_passphrase_len)) return 0;
    if (a->run_requested != b->run_requested) return 0;
    if (a->mode != b->mode) return 0;
    if (a->raw_tx_rate != b->raw_tx_rate) return 0;
    if (a->sta_driver_tx != b->sta_driver_tx) return 0;
    if (a->sta_bssid_check_disabled != b->sta_bssid_check_disabled) return 0;
    if (a->sta_ampdu_enabled != b->sta_ampdu_enabled) return 0;
    if (a->sta_11b_rates_disabled != b->sta_11b_rates_disabled) return 0;
    if (a->sta_raw_rx_enabled != b->sta_raw_rx_enabled) return 0;
    return 1;
}
