## boot/bootloader_components/main/Kconfig.projbuild
```kconfig
menu "Stage2"

    config WL_BOOT_BUTTON_GPIO
        int "Entry button GPIO (-1 disables)"
        default -1
        help
            Held at its active level for about 300 ms after reset, this pin
            selects the loader. Do not use a strapping pin (GPIO0 on ESP32,
            GPIO9 on ESP32-C6): it would start ROM download mode instead.

    config WL_BOOT_BUTTON_ACTIVE_LOW
        bool "Entry button is active low (pulled up internally)"
        default y

    config WL_BOOT_QUICK_RESETS
        int "Quick resets that select the loader"
        default 5

    config WL_BOOT_QUICK_WINDOW_TICKS
        int "Quick reset window, RTC slow-clock ticks (about 5 s)"
        default 1000000

    config WL_BOOT_TRIAL_PASS_TICKS
        int "A flash-mode trial passes when the next reset comes after this long (about 30 s)"
        default 6000000

    config WL_BOOT_ABNORMAL_RESETS
        int "Watchdog / brown-out resets that select the loader"
        default 5

    config WL_BOOT_ABNORMAL_WINDOW_TICKS
        int "Abnormal reset window, RTC slow-clock ticks (about 60 s)"
        default 12000000

endmenu
```

## components/espmod_host/Kconfig
```kconfig
menu "esp-xip-modules host"

    config ESPMOD_REQUEST_MAX
        int "Largest request a module can receive"
        default 1024
        help
            Size of the per-module inbox (espmod_instance_post / espmod_instance_request).

    config ESPMOD_RESPONSE_MAX
        int "Largest answer a module can give with respond()"
        default 1024

    config ESPMOD_WORKER_STACK
        int "Stack of the worker task that runs every module's handlers, bytes"
        default 12288
        help
            Must cover the deepest handler of any installed module (a module image states its need in stack_bytes).

    config ESPMOD_WORKER_PRIORITY
        int "Priority of the worker task"
        default 5

    config ESPMOD_HANDLER_MS
        int "Handler time budget, ms"
        default 20
        help
            A handler that runs longer is logged and counted (espmod_stats_t.overruns).

    config ESPMOD_EVENT_QUEUE
        int "Events queued for the worker (interrupts, alarms, requests)"
        default 32

    config ESPMOD_PKT_SLOTS
        int "Packets in the host's own pool, at most (1204 bytes each, allocated one by one as modules use them)"
        default 16

    config ESPMOD_PKT_KEEP
        int "Idle packets that keep their storage (the rest go back to the heap when released)"
        default 2

    config ESPMOD_PKT_HEAP_RESERVE
        int "Free heap that must remain after a packet is allocated, bytes"
        default 16384
        help
            A module cannot take the last RAM of the device for packets. DMesh does not use this pool: it hands the QUIC pool to the host.

    config ESPMOD_PKT_RESERVE
        int "Packets a module cannot take: kept for the application"
        default 2

    config ESPMOD_PKT_HELD
        int "Packets one module can hold at a time (at most 8)"
        default 4
        range 1 8

    config ESPMOD_PKT_INBOX
        int "Packets that can wait for one module"
        default 4

    config ESPMOD_MEM_QUOTA
        int "Bytes one module can take with mem_alloc"
        default 8192

    config ESPMOD_SERIAL_STACK
        int "Stack of the serial reader task (it runs the line handler), bytes"
        default 8192

    config ESPMOD_SPI_MAX_TRANSFER
        int "Largest SPI transfer, bytes"
        default 272
        help
            An SX126x read of a 255-byte packet needs 255 + 4.

endmenu
```

## components/xip_ble/Kconfig
```kconfig
menu "esp-xip-modules BLE (xip_ble)"

    config XIP_BLE
        bool "BLE component (advertising, scan, CoC channel, bonds, wake/sleep modes)"
        depends on BT_ENABLED && BT_NIMBLE_ENABLED
        default n
        help
            Builds a thin subset of NimBLE (advertising with the caller's data, scan with the caller's filters, one LE CoC channel, bonds, wake/sleep
            modes) and offers get_component("nimble"). The policy is the caller's (modules/mod_ble hosts the `ble` component, 104). Off: the component is a stub that offers
            nothing and links no Bluetooth code. Also set CONFIG_BT_ENABLED=n to leave the controller and the host out of the image
            (profiles/off.defaults); the options of the NimBLE stack itself (roles, connections, bonds, buffers) are the bt component's and are
            set with the profile files in components/xip_ble/profiles (README.md has the measured table).

    config XIP_BLE_COC
        bool "LE CoC channel (listen, connect, bearer)"
        depends on XIP_BLE
        default y
        help
            One L2CAP connection-oriented channel with a single-record transmit buffer. Needs CONFIG_BT_NIMBLE_L2CAP_COC_MAX_NUM >= 1.
            Off: advertising, scan and bonds only.

    config XIP_BLE_COC_MTU
        int "Largest CoC SDU size a module may ask for, bytes"
        depends on XIP_BLE_COC
        range 256 1500
        default 1500
        help
            The limit, and the MTU of the runtime link "ble". The module that starts the stack chooses the SDU size of the channel (nimble.start: coc_mtu) and the
            pool is allocated with it then, not at build time. One QUIC packet is one SDU. 1500 is XIP_PKT_MAX, the payload of every pool packet and of the ESP-NOW link; quic-lite's own limit is 1100 today.
            The receive copy is on the NimBLE host task stack, so this also bounds that stack use.

    config XIP_BLE_COC_BUFS
        int "Most CoC buffers a module may ask for (one SDU each)"
        depends on XIP_BLE_COC
        range 3 8
        default 3
        help
            One channel needs the receive buffer posted to NimBLE, the received SDU while it is copied into a pool packet, and the transmit mbuf: 3, which
            is also the least nimble.start accepts. The module chooses the count (coc_buffers) when it starts the stack. The connect request's buffer becomes
            the receive buffer, so it is not an extra one.

    config XIP_BLE_SCAN_CACHE
        int "Scan cache entries (distinct advertisers kept for ble.scan_results)"
        depends on XIP_BLE
        range 0 16
        default 8
        help
            9 bytes each, static. 0 builds the cache out (scan results are then only counted, with the last one in the status).

    config XIP_BLE_LOG_LEVEL
        int "Log lines of the BLE mechanics (0 none, 1 failures, 2 all)"
        depends on XIP_BLE
        range 0 2
        default 2
        help
            The lines are the former "event type=ble.*" records. Level 0 removes the strings and the formatting from the image.

    config XIP_BLE_RELEASE_WHEN_OFF
        bool "Release the BLE controller memory when the application boots with BLE off"
        depends on XIP_BLE
        default n
        help
            xip_ble_configure_boot(false) calls esp_bt_mem_release(): the controller's static memory returns to the heap for this boot,
            and BLE cannot start until the next reboot with the boot flag on. Leave it off when BLE may be started later by a request.

endmenu
```

## components/xip_runtime/Kconfig
```kconfig
menu "esp-xip-modules host"

    config XIP_ESPNOW_DIAGNOSTICS
        bool "Detailed ESP-NOW callback diagnostics"
        default n
        help
            Allocate per-epoch callback/error counters while NOW is enabled.
            Normal packet flow counters remain in the link/transport layer.

    config XIP_REQUEST_MAX
        int "Largest request a module can receive"
        default 1024
        help
            Size of the per-module inbox (xip_instance_post / xip_instance_request).

    config XIP_RESPONSE_MAX
        int "Largest answer a module can give with reply()"
        default 1024

    config XIP_WORKER_STACK
        int "Stack of the worker task that runs every module's handlers, bytes"
        default 32768
        help
            Must cover the deepest handler of any installed module (a module image states its need in stack_bytes).
            QUIC receive/handshake and installed flashers can nest sizeable
            decode, stream and native-service frames. The default is 32 KiB.

    config XIP_WORKER_PRIORITY
        int "Priority of the worker task"
        default 5

    config XIP_HANDLER_MS
        int "Handler time budget, ms"
        default 20
        help
            A handler that runs longer is logged and counted (xip_stats_t.overruns).

    config XIP_EVENT_QUEUE
        int "Events queued for the worker (interrupts, alarms, requests)"
        default 32

    config XIP_PKT_SLOTS
        int "Packets in the host's own pool, at most (1704 bytes each, allocated one by one as modules use them)"
        default 64
        range 1 32767

    config XIP_PKT_KEEP
        int "Idle packets that keep their storage (the rest go back to the heap when released)"
        default 4
        range 0 32767

    config XIP_PKT_HEAP_RESERVE
        int "Free heap that must remain after a packet is allocated, bytes"
        default 16384
        help
            A module cannot take the last RAM of the device for packets. The pool is shared by modules, QUIC endpoints and native links.

    config XIP_PKT_QUEUE_INITIAL
        int "Initial capacity of the shared packet delivery queue"
        default 32
        range 1 512
        help
            Only queue descriptors are allocated up front. One global FIFO holds pool references for every module.
            The worker grows descriptors as short bursts require and heap permits. Payload storage remains lazy,
            bounded by XIP_PKT_SLOTS and XIP_PKT_HEAP_RESERVE; receivers drop when storage is unavailable.

    config XIP_PACKET_STATS
        bool "Packet queue high-water and drop counters"
        default y
        help
            Keep counters together in the queue state. Device status reports the queue and pool snapshot.

    config XIP_MEM_QUOTA
        int "Optional per-module allocation limit in bytes (0: use available heap)"
        default 0
        range 0 2147483647
        help
            All modules have access to mem_alloc. Host allocations leave at
            least 32 KiB free at allocation time. A nonzero value also caps
            the total outstanding allocation of each module.

    config XIP_SERIAL_STACK
        int "Stack of the serial reader task (it runs the line handler), bytes"
        default 8192

    config XIP_SPI_MAX_TRANSFER
        int "Largest SPI transfer, bytes"
        default 272
        help
            An SX126x read of a 255-byte packet needs 255 + 4.

    config XIP_QUIC_UDP
        bool "Receive QUIC datagrams on the default UDP port for the application"
        default y
        help
            In active IP mode, deliver UDP datagrams to the common QUIC receive function (xip_quic_rx_set),
            unparsed, as frames of the link "udp". Uses the shared readiness owner; no private task or receive buffer.
            Standalone NAN/NOW operation has no listener. Off: no socket.

    config XIP_QUIC_UDP_PORT
        int "Default UDP port of QUIC packets"
        depends on XIP_QUIC_UDP
        default 3339


endmenu
```

## main/Kconfig.projbuild
```kconfig
menu "Standalone C application"
    config ESPMOD_C_LOADER
        bool "Run the C module host as the loader"
        default n
endmenu
```
